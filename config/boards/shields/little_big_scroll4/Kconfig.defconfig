## config/boards/shields/little_big_scroll4/Kconfig.defconfig
```kconfig
if SHIELD_LITTLE_BIG_SCROLL4

config ZMK_KEYBOARD_NAME
    default "LittleBigScroll4"

endif
```

## config/boards/shields/little_big_scroll4/Kconfig.shield
```kconfig
# Copyright (c) 2022 The ZMK Contributors
# SPDX-License-Identifier: MIT

config SHIELD_LITTLE_BIG_SCROLL4
	def_bool $(shields_list_contains,little_big_scroll4)
```
